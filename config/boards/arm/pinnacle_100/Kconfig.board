## config/boards/arm/pinnacle_100/Kconfig.board
```kconfig
# Copyright (c) 2024 ZMK Firmware
# SPDX-License-Identifier: Apache-2.0

config BOARD_PINNACLE_100
    bool "Pinnacle 100"
    help
      Nordic Semiconductor Pinnacle 100 development board
      featuring the nRF52840 ARM Cortex-M4F processor.
```

## config/boards/arm/pinnacle_100/Kconfig.defconfig
```kconfig
# Copyright (c) 2024 ZMK Firmware
# SPDX-License-Identifier: Apache-2.0

if BOARD_PINNACLE_100

config BOARD
    default "pinnacle_100"

config BOARD_ENABLE_DCDC
    default y

config ZMK_BLE
    default y

config ZMK_BLE_GATT
    default y

config ZMK_USB
    default y

endif # BOARD_PINNACLE_100
```
